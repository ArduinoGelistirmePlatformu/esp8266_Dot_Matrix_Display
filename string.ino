void stringToDisplay ( String s , int x, int y, int t) {
  for ( int i = 0; i < s.length(); i++ ) {
    char2Arr(stringtoshort(s.substring(i, i + 1)), x -= 6, y);
    delayMicroseconds(t);
  } refresh_display();
}
unsigned short stringtoshort ( String s ) {
  //Serial.print("stringtoshor= ");Serial.println(s);
  if ( s == " " ) return 32;
  else if ( s == "!" ) return 33;
  else if ( s == "'" ) return 34;
  else if ( s == "#" ) return 35;
  else if ( s == "$" ) return 36;
  else if ( s == "%" ) return 37;
  else if ( s == "&" ) return 38;
  else if ( s == "'" ) return 39;
  else if ( s == "." ) return 46;
  else if ( s == "/" ) return 47;
  else if ( s == ":" ) return 58;
  else if ( s == "=" ) return 61;
  else if ( s == "_" ) return 95;
  else if ( s == "+" ) return 43;
  else if ( s == "-" ) return 45;
  else if ( s == "~" ) return 126;
  else if ( s ==  "" ) return 127;
  else if ( s == ")" ) return 41;
  else if ( s == "(" ) return 40;
  else if ( s == "{" ) return 123;
  else if ( s == "}" ) return 125;
  else if ( s == "|" ) return 124;

  else if ( s == "0" ) return 48;
  else if ( s == "1" ) return 49;
  else if ( s == "2" ) return 50;
  else if ( s == "3" ) return 51;
  else if ( s == "4" ) return 52;
  else if ( s == "5" ) return 53;
  else if ( s == "6" ) return 54;
  else if ( s == "7" ) return 55;
  else if ( s == "8" ) return 56;
  else if ( s == "9" ) return 57;

  else if ( s == "A" ) return 65;
  else if ( s == "B" ) return 66;
  else if ( s == "C" || s == "Ç" ) return 67;
  else if ( s == "D" ) return 68;
  else if ( s == "E" ) return 69;
  else if ( s == "F" ) return 70;
  else if ( s == "G" ) return 71;
  else if ( s == "H" ) return 72;
  else if ( s == "I" || s == "İ" ) return 73;
  else if ( s == "J" ) return 74;
  else if ( s == "K" ) return 75;
  else if ( s == "L" ) return 76;
  else if ( s == "M" ) return 77;
  else if ( s == "N" ) return 78;
  else if ( s == "O" || s == "Ö" ) return 79;
  else if ( s == "P" ) return 80;
  else if ( s == "Q" ) return 81;
  else if ( s == "R" ) return 82;
  else if ( s == "S" ) return 83;
  else if ( s == "T" ) return 84;
  else if ( s == "U" || s == "Ü" ) return 85;
  else if ( s == "V" ) return 86;
  else if ( s == "W" ) return 87;
  else if ( s == "X" ) return 88;
  else if ( s == "Y" ) return 89;
  else if ( s == "Z" ) return 90;

  else if ( s == "a" ) return 97;
  else if ( s == "b" ) return 98;
  else if ( s == "c" || s == "ç" ) return 99;
  else if ( s == "d" ) return 100;
  else if ( s == "e" ) return 101;
  else if ( s == "f" ) return 102;
  else if ( s == "g" ) return 103;
  else if ( s == "h" ) return 104;
  else if ( s == "i" || s == "ı" ) return 105;
  else if ( s == "j" ) return 106;
  else if ( s == "k" ) return 107;
  else if ( s == "l" ) return 108;
  else if ( s == "m" ) return 109;
  else if ( s == "n" ) return 110;
  else if ( s == "o" || s == "ö" ) return 111;
  else if ( s == "p" ) return 112;
  else if ( s == "q" ) return 113;
  else if ( s == "r" ) return 114;
  else if ( s == "s" ) return 115;
  else if ( s == "t" ) return 116;
  else if ( s == "u" || s == "ü" ) return 117;
  else if ( s == "v" ) return 118;
  else if ( s == "w" ) return 119;
  else if ( s == "x" ) return 120;
  else if ( s == "y" ) return 121;
  else if ( s == "z" ) return 122;
}
unsigned short const font1[96][9] = {
  { 0x07, 0x00, 0x00, 0x00, 0x00, 0x00, 0x00, 0x00, 0x00 },   // 0x20, Space
  { 0x07, 0x04, 0x04, 0x04, 0x04, 0x04, 0x00, 0x04, 0x00 },   // 0x21, !
  { 0x07, 0x10, 0x28, 0x10, 0x03, 0x04, 0x04, 0x03, 0x00 },   // 0x22, ' Derece İşareti
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  { 0x07, 0x1f, 0x1f, 0x1f, 0x1f, 0x1f, 0x1f, 0x1f, 0x00 }    // 0x7f, DEL
};
//*************************************************************************************************
const unsigned short Init[7][2] = { { 0x0C, 0x00 },    // display off
  { 0x00, 0xFF },
  { 0x09, 0x00 },
  { 0x0F, 0x00 },
  { 0x0B, 0x07 },
  { 0x0A, 0x04 },
  { 0x0C, 0x01 }
};
//**************************************************************************************************
void max7219_init() {
  unsigned short i, j;
  for (i = 0; i < 7; i++) {
    digitalWrite(CS, LOW);
    delayMicroseconds(1);
    for (j = 0; j < MAXS; j++) {
      SPI.write(Init[i][0]);
      SPI.write(Init[i][1]);
    }
    digitalWrite(CS, HIGH);
  }
}
//**************************************************************************************************
void max7219_set_br(unsigned short br)
{
  unsigned short j;
  if (br < 16) {
    digitalWrite(CS, LOW);
    delayMicroseconds(1);
    for (j = 0; j < MAXS; j++) {
      SPI.write(0x0A);
      SPI.write(br);
    }
    digitalWrite(CS, HIGH);
  }
}
//**************************************************************************************************
void led_init(void) {
  unsigned short i, j, k;
  j = 0;
  k = 0;
  for (i = 0; i < MAXS * 8; i++) {
    HMAX[i] = (1 << j);   //bitmask
    LMAX[i] = k;
    j++;
    if (j > 7) {
      j = 0;
      k++;
    }
  }
}
//**************************************************************************************************
void clear_Display() {
  unsigned short i, j;
  for (i = 0; i < 8; i++)
  {
    digitalWrite(CS, LOW);
    delayMicroseconds(1);
    for (j = MAXS; j > 0; j--) {
      LED[j - 1][i] = 0;
      SPI.write(i + 1);
      SPI.write(LED[j - 1][i]);
    }
    digitalWrite(CS, HIGH);
  }
}
//**************************************************************************************************
void refresh_display()
{
  unsigned short i, j;

  for (i = 0; i < 8; i++)
  {
    digitalWrite(CS, LOW);
    delayMicroseconds(1);
    for (j = MAXS; j > 0; j--) {
      SPI.write(i + 1);
      SPI.write(LED[j - 1][i]);
    }
    digitalWrite(CS, HIGH);
  }
}
//**************************************************************************************************
void char2Arr(unsigned short ch, int PosX, short PosY) {
  int i, j, k, l, m, o1, o2, o3, o4;
  PosX++;
  k = ch - 32;
  if ((k >= 0) && (k < 96)) {
    o4 = font1[k][0];
    o3 = 1 << (o4 - 2);
    for (i = 0; i < o4; i++) {
      if (((PosX - i <= maxX) && (PosX - i >= 0))
          && ((PosY > -8) && (PosY < 8))) {
        o1 = HMAX[PosX - i];
        o2 = LMAX[PosX - i];
        for (j = 0; j < 8; j++) {
          if (((PosY >= 0) && (PosY <= j)) || ((PosY < 0) && (j < PosY + 8))) {
            l = font1[k][j + 1];
            m = (l & (o3 >> i));
            if (m > 0)
              LED[o2][j - PosY] = LED[o2][j - PosY] | (o1);
            else
              LED[o2][j - PosY] = LED[o2][j - PosY] & (~o1);
          }
        }
      }
    }
  }
}
